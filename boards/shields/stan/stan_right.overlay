#include "stan.dtsi" // The shared dtsi file is included in the overlay


&default_transform { // Offset of 5 because the left side has 5 columns
    col-offset = <5>;
};


// Label of the kscan node in the dtsi
&kscan0 {
    col-gpios = 
            <&pro_micro 14 GPIO_ACTIVE_HIGH>,
            <&pro_micro 15 GPIO_ACTIVE_HIGH>,
            <&pro_micro 18 GPIO_ACTIVE_HIGH>,
            <&pro_micro 19 GPIO_ACTIVE_HIGH>, 
            <&pro_micro 20 GPIO_ACTIVE_HIGH>;
};